## template/config/west.yml
```yaml
manifest:
  remotes:
    - name: zmkfirmware
      url-base: https://github.com/zmkfirmware
    - name: refil
      url-base: https://github.com/refil
  projects:
    - name: zephyr # Tandem's tested commit of v3.5.0+zmk-fixes
      remote: zmkfirmware
      revision: dacab4875df72109b96cc8977547a0dc04875bcd
      import:
        name-allowlist:
          - cmsis
          - hal_nordic
          - tinycrypt
          - lvgl
          - segger
    - name: zmk
      remote: refil
      revision: d93499bb877f2711989e6cbbe1feed9e9a792ca3 # Tandem's tested commit of adv360-z3.5-2
      import:
        file: app/west.yml
        name-allowlist:
          - zephyr
          - cmsis
          - hal_nordic
          - tinycrypt
          - lvgl
          - segger
          - nanopb
          - zmk-studio-messages
  self:
    path: config
```
